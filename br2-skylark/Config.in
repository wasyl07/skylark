## br2-skylark/Config.in
```kconfig
menu "Skylark"
source "$BR2_EXTERNAL_SKYLARK_PATH/package/skylark-config/Config.in"
endmenu
```

## br2-skylark/configs/skylark_bbb_defconfig
```kconfig
# Architecture
BR2_arm=y
BR2_cortex_a8=y
BR2_ARM_FPU_VFPV3=y

# Toolchain: Bootlin prebuilt glibc (systemd needs glibc).
# bleeding-edge: kernel headers 5.15 (systemd-networkd needs >= 5.4; stable has 4.19)
BR2_TOOLCHAIN_EXTERNAL=y
BR2_TOOLCHAIN_EXTERNAL_BOOTLIN=y
BR2_TOOLCHAIN_EXTERNAL_BOOTLIN_ARMV7_EABIHF_GLIBC_BLEEDING_EDGE=y

# Build
BR2_DL_DIR="$(BR2_EXTERNAL_SKYLARK_PATH)/../dl"
BR2_GLOBAL_PATCH_DIR="$(BR2_EXTERNAL_SKYLARK_PATH)/board/skylark/patches"
BR2_DOWNLOAD_FORCE_CHECK_HASHES=y

# System
BR2_INIT_SYSTEMD=y
BR2_TARGET_GENERIC_HOSTNAME="skylark"
BR2_TARGET_GENERIC_ISSUE="Skylark Flight Controller"
BR2_TARGET_GENERIC_ROOT_PASSWD="skylark"
BR2_TARGET_GENERIC_GETTY_PORT="ttyS4"
BR2_ROOTFS_OVERLAY="$(BR2_EXTERNAL_SKYLARK_PATH)/board/skylark/rootfs-overlay"
BR2_ROOTFS_POST_BUILD_SCRIPT="$(BR2_EXTERNAL_SKYLARK_PATH)/board/skylark/post-build.sh"
BR2_ROOTFS_POST_IMAGE_SCRIPT="$(BR2_EXTERNAL_SKYLARK_PATH)/board/skylark/post-image.sh"

# Kernel: BeagleBoard.org TI 6.6 tree (PRU remoteproc/rpmsg, cape support)
BR2_LINUX_KERNEL=y
BR2_LINUX_KERNEL_CUSTOM_TARBALL=y
BR2_LINUX_KERNEL_CUSTOM_TARBALL_LOCATION="$(call github,beagleboard,linux,6.6.58-ti-arm32-r10)/linux-6.6.58-ti-arm32-r10.tar.gz"
BR2_LINUX_KERNEL_DEFCONFIG="bb.org"
BR2_LINUX_KERNEL_CONFIG_FRAGMENT_FILES="$(BR2_EXTERNAL_SKYLARK_PATH)/board/skylark/linux.fragment"
BR2_LINUX_KERNEL_DTS_SUPPORT=y
BR2_LINUX_KERNEL_INTREE_DTS_NAME="ti/omap/am335x-boneblack"
BR2_LINUX_KERNEL_NEEDS_HOST_OPENSSL=y
BR2_LINUX_KERNEL_INSTALL_TARGET=y

# U-Boot
BR2_TARGET_UBOOT=y
BR2_TARGET_UBOOT_BUILD_SYSTEM_KCONFIG=y
BR2_TARGET_UBOOT_CUSTOM_VERSION=y
BR2_TARGET_UBOOT_CUSTOM_VERSION_VALUE="2025.01"
BR2_TARGET_UBOOT_BOARD_DEFCONFIG="am335x_evm"
BR2_TARGET_UBOOT_CONFIG_FRAGMENT_FILES="$(BR2_EXTERNAL_SKYLARK_PATH)/board/skylark/uboot.fragment"
BR2_TARGET_UBOOT_NEEDS_DTC=y
BR2_TARGET_UBOOT_NEEDS_OPENSSL=y
BR2_TARGET_UBOOT_NEEDS_GNUTLS=y
# BR2_TARGET_UBOOT_FORMAT_BIN is not set
BR2_TARGET_UBOOT_FORMAT_IMG=y
BR2_TARGET_UBOOT_SPL=y
BR2_TARGET_UBOOT_SPL_NAME="MLO"

# Root filesystem (one A/B slot)
BR2_TARGET_ROOTFS_EXT2=y
BR2_TARGET_ROOTFS_EXT2_4=y
BR2_TARGET_ROOTFS_EXT2_LABEL="rootfs"
BR2_TARGET_ROOTFS_EXT2_SIZE="512M"
# BR2_TARGET_ROOTFS_TAR is not set

# RAUC
BR2_PACKAGE_RAUC=y
BR2_PACKAGE_RAUC_DBUS=y
BR2_PACKAGE_RAUC_JSON=y
BR2_PACKAGE_HOST_RAUC=y
BR2_PACKAGE_UBOOT_TOOLS=y
BR2_PACKAGE_UBOOT_TOOLS_FWPRINTENV=y
BR2_PACKAGE_SQUASHFS=y

# Skylark integration
BR2_PACKAGE_SKYLARK_CONFIG=y

# Kernel modules, sensors, CAN
BR2_PACKAGE_KMOD=y
BR2_PACKAGE_KMOD_TOOLS=y
BR2_PACKAGE_HOST_KMOD_XZ=y
BR2_PACKAGE_XZ=y
BR2_PACKAGE_LIBIIO=y
BR2_PACKAGE_CAN_UTILS=y
# full ip(8): 'ip -d link show can0' (busybox ip has no CAN details)
BR2_PACKAGE_IPROUTE2=y
BR2_PACKAGE_I2C_TOOLS=y

# Networking
BR2_PACKAGE_DROPBEAR=y

# Host tools for image generation
BR2_PACKAGE_HOST_DOSFSTOOLS=y
BR2_PACKAGE_HOST_GENIMAGE=y
BR2_PACKAGE_HOST_MTOOLS=y
BR2_PACKAGE_HOST_UBOOT_TOOLS=y
BR2_PACKAGE_HOST_E2FSPROGS=y
BR2_PACKAGE_HOST_DTC=y
```

## br2-skylark/package/skylark-config/Config.in
```kconfig
config BR2_PACKAGE_SKYLARK_CONFIG
	bool "skylark-config"
	depends on BR2_INIT_SYSTEMD
	depends on BR2_TOOLCHAIN_HEADERS_AT_LEAST_5_4 # systemd-networkd
	select BR2_PACKAGE_E2FSPROGS
	select BR2_PACKAGE_E2FSPROGS_RESIZE2FS
	select BR2_PACKAGE_UTIL_LINUX
	select BR2_PACKAGE_UTIL_LINUX_PARTX
	select BR2_PACKAGE_UTIL_LINUX_BINARIES
	select BR2_PACKAGE_UTIL_LINUX_HWCLOCK
	select BR2_PACKAGE_SYSTEMD_NETWORKD
	select BR2_PACKAGE_SYSTEMD_RESOLVED
	select BR2_PACKAGE_SYSTEMD_TIMESYNCD
	help
	  Skylark system integration: /data partition handling
	  (grow-to-fill + first-boot init), factory reset tool and
	  RAUC mark-good service, networkd config (DHCP eth0, can0 at
	  1 Mbit/s), DS1307 RTC restore and NTP->RTC sync.
```
